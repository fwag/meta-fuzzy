## conf/distro/fuzzynux.conf
```bitbake
include poky.conf

DISTRO_NAME = "Fuzzynux"
DISTRO_VERSION = "0.5.10"
DISTRO_FEATURES_append = " systemd smack pam"
VIRTUAL-RUNTIME_init_manager = "systemd"
DISTRO_FEATURES_BACKFILL_CONSIDERED = "sysvinit"
VIRTUAL-RUNTIME_initscripts = ""
DISTRO_FEATURES_remove = "alsa bluetooth pcmcia 3g nfc x11 opengl wayland vulkan pulseaudio"
#INHERIT += "cve-check"
PACKAGE_CLASSES ?= "package_rpm"
require conf/distro/include/security_flags.inc
```

## conf/machine/ucs.conf
```bitbake
#@TYPE: Machine
#@NAME: UCS Series

#@DESCRIPTION: Machine configuration for 64 bit Intel Core i7 CPU (and later) with MMX, SSE, SSE2, SSE3, and SSSE3 instruction set support. Supports a moderately wide range of drivers that should boot and be usable on "typical" hardware.

require conf/machine/include/meta-intel.inc
require conf/machine/include/intel-corei7-64-common.inc
require conf/machine/include/intel-common-pkgarch.inc

MACHINEOVERRIDES =. "intel-corei7-64:x86-64:"

MACHINE_FEATURES += " pcbios"
MACHINE_FEATURES += " intel-ucode"

INHERIT += " image-buildinfo"

PREFERRED_PROVIDER_virtual/kernel = "linux-fuzzy"
PREFERRED_PROVIDER_virtual/kernel_poky-tiny = "linux-fuzzy"
PREFERRED_VERSION_linux-intel = "5.10%"

#KERNEL_CLASSES += "kernel-fitimage"
KERNEL_IMAGETYPE = "bzImage"

#IMAGE_CLASSES += "dm-verity-img"
#IMAGE_FSTYPES += "ext4"
#DM_VERITY_IMAGE = "fuzzy-image"
#DM_VERITY_IMAGE_TYPE = "ext4"

#INITRAMFS_IMAGE = "dm-verity-image-initramfs"
#INITRAMFS_IMAGE_BUNDLE = "1"
#INITRAMFS_FSTYPES = "cpio.gz"

EFI_PROVIDER_ucs = "grub-efi"

# Enable optional dpdk:
COMPATIBLE_MACHINE_pn-dpdk = "intel-corei7-64"

# Enable optional QAT items:
COMPATIBLE_MACHINE_pn-qat16 = "intel-corei7-64"
COMPATIBLE_MACHINE_pn-qat17 = "intel-corei7-64"
COMPATIBLE_MACHINE_pn-zlib-qat = "intel-corei7-64"


SYSLINUX_OPTS = "serial 0 115200"
SERIAL_CONSOLES = "115200;ttyS0 115200;ttyS1 115200;ttyS2"
#APPEND += "rootwait console=ttyS0,115200 console=tty0"

IMAGE_FSTYPES += " ext4 hddimg"
WKS_FILE ?= "grub-bootdisk-microcode.wks.in"
WKS_FILE_DEPENDS_append = " intel-microcode"

INHERIT += "mender-full"

MENDER_ARTIFACT_NAME = "fuzzy-ucs-image-${DISTRO_VERSION}"
MENDER_FEATURES_ENABLE_append = " mender-grub mender-partuuid mender-bios mender-image-gpt"
MENDER_FEATURES_DISABLE_append = " mender-uboot mender-image-sd mender-image-uefi"
MENDER_STORAGE_TOTAL_SIZE_MB = "2048"
MENDER_DATA_PART_SIZE_MB = "1024"

MENDER_SERVER_URL = "https://mender.server.test"

# UUID's generated using the 'uuidgen -r' command
MENDER_BOOT_PART = "/dev/disk/by-partuuid/ee8dc83c-ade5-4147-b656-a21a0d851bd9"
MENDER_ROOTFS_PART_A = "/dev/disk/by-partuuid/ee8c1041-c10a-461d-a651-4533d5448ad8"
MENDER_ROOTFS_PART_B = "/dev/disk/by-partuuid/ee869b14-7d6e-42bc-8e6a-e0a1f570b13b"
MENDER_DATA_PART = "/dev/disk/by-partuuid/ee8de97b-1a47-44b1-a95a-296c02f1e3e1"

MENDER_STORAGE_DEVICE=""

PACKAGECONFIG_append_pn-grub-mender-grubenv = " debug-log"
```

## conf/machine/ucs_luks.conf
```bitbake
#@TYPE: Machine
#@NAME: UCS with secure boot support and LUKS full disk encryption relying on TPM2

#@DESCRIPTION: Machine configuration for 64 bit Intel Core i7 CPU (and later) with MMX, SSE, SSE2, SSE3, and SSSE3 instruction set support. Supports a moderately wide range of drivers that should boot and be usable on "typical" hardware.

require conf/machine/ucs_secureboot.conf

MACHINEOVERRIDES =. "intel-corei7-64:x86-64:ucs_uefi:ucs_secureboot:"
```

## conf/machine/ucs_secureboot.conf
```bitbake
#@TYPE: Machine
#@NAME: UCS with secure boot support

#@DESCRIPTION: Machine configuration for 64 bit Intel Core i7 CPU (and later) with MMX, SSE, SSE2, SSE3, and SSSE3 instruction set support. Supports a moderately wide range of drivers that should boot and be usable on "typical" hardware.

require conf/machine/ucs_uefi.conf

MACHINEOVERRIDES =. "intel-corei7-64:x86-64:ucs_uefi:"

MENDER_FEATURES_ENABLE_remove = "mender-partuuid"
MENDER_FEATURES_DISABLE_append = "mender-partuuid"

IMAGE_FSTYPES_remove = " hddimg"

MENDER_STORAGE_TOTAL_SIZE_MB          = "4096"
MENDER_DATA_PART_SIZE_MB              = "1024"
MENDER_BOOT_PART_SIZE_MB              = "256"

MENDER/KERNEL_PART_SIZE_MB            = "256"

MENDER_STORAGE_DEVICE = "/dev/sda"
MENDER_STORAGE_DEVICE_BASE = "${MENDER_STORAGE_DEVICE}"
MENDER_BOOT_PART = "${MENDER_STORAGE_DEVICE_BASE}1"
MENDER_ROOTFS_PART_A = "${MENDER_STORAGE_DEVICE_BASE}2"
MENDER_ROOTFS_PART_B = "${MENDER_STORAGE_DEVICE_BASE}3"
MENDER_DATA_PART = "${MENDER_STORAGE_DEVICE_BASE}4"
```
